## sdkconfig.defaults
```kconfig
# Classic Bluetooth HID keyboard (for PS5 compatibility)
CONFIG_BT_ENABLED=y
CONFIG_BT_BLUEDROID_ENABLED=y
CONFIG_BT_CLASSIC_ENABLED=y
CONFIG_BT_A2DP_ENABLE=n
CONFIG_BT_SPP_ENABLED=n
CONFIG_BT_HID_ENABLED=y
CONFIG_BT_HID_DEVICE_ENABLED=y
CONFIG_BT_SSP_ENABLED=y
CONFIG_BT_BLE_ENABLED=n
CONFIG_BT_GATTS_ENABLE=n
CONFIG_BT_GATTC_ENABLE=n
CONFIG_BT_BLE_SMP_ENABLE=n

# HTTP server WebSocket support
CONFIG_HTTPD_WS_SUPPORT=y
```
